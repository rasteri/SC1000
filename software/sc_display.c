/*
 * SC1000 / SC500 - SSD1306 128x64 OLED display
 *
 * Full-screen zoomed waveform of the sample track played with the platter
 * (deck[1]): it scrolls left/right under a fixed centre cursor as you move
 * the jog wheel.
 *
 * WIRING - the OLED shares /dev/i2c-0 with the AS5601 jog sensor (0x36):
 *      SCL -> R13 pad (ROT_SCL)   near the rotary sensor
 *      SDA -> R12 pad (ROT_SDA)
 *      VCC -> 3.3V,  GND -> GND   (e.g. J7 pins 2 / 1)
 * i2c-1 (the J7 EXPANSION bus) is unusable here: on this A13 kernel a bus
 * with no other users goes "cold" and every transfer times out once xwax's
 * realtime audio thread is running. i2c-0 stays alive because the jog is
 * polled hundreds of times a second.
 *
 * To avoid disturbing the jog read (which would glitch the scratch audio),
 * every i2c-0 access is serialised with sc_input.c's i2c0_lock and split
 * into small chunks, so process_rot()'s jog read never waits behind more
 * than one short transfer.
 *
 * The driver never probes/scans - it talks only to OLED_ADDR.
 */

#ifndef _GNU_SOURCE
#define _GNU_SOURCE          /* SCHED_IDLE, pthread_setschedparam */
#endif

#include <stdio.h>
#include <stdarg.h>
#include <stdlib.h>
#include <string.h>
#include <stdint.h>
#include <unistd.h>
#include <fcntl.h>
#include <errno.h>
#include <pthread.h>
#include <sched.h>
#include <sys/ioctl.h>
#include <linux/i2c-dev.h>

#include "xwax.h"        /* struct deck deck[2], scsettings            */
#include "deck.h"
#include "player.h"
#include "track.h"       /* track_get_ppm / track_get_overview         */
#include "status.h"      /* status() - current xwax status string      */
#include "sc_display.h"

/* ---- configuration -------------------------------------------------------- */

#define OLED_BUS        "/dev/i2c-0"  /* shared with the jog sensor - see top */
#define OLED_ADDR       0x3C          /* try 0x3D if i2cset says so       */
#define OLED_W          128
#define OLED_H          64
#define OLED_PAGES      (OLED_H / 8)
#define OLED_FB_LEN     (OLED_W * OLED_PAGES)

#define OLED_CHUNK      24            /* max data bytes per I2C write, so the
                                        jog read waits at most one short xfer */
#define OLED_REFRESH_US 8000          /* pause between full flushes (~picture rate
                                        is limited by the flush itself anyway) */

/* Flip if the panel is mounted upside down in your enclosure */
#define OLED_ROTATE180  0

/* Waveform view. Smaller WINDOW = more zoom. */
#define WF_WINDOW_SEC   0.6           /* seconds of audio shown across 128 px */
#define WF_MID          30            /* wave centre line                   */
#define WF_AMP          29            /* half-height of the wave, in pixels */
#define WF_AUTOGAIN     1             /* scale up quiet (not silent) samples */
#define WF_STYLE        2             /* 0 = filled, 1 = silhouette, 2 = shaded */
#define WF_SHADE_TOP    16            /* dither density at centre line (0..16)  */
#define WF_SHADE_EDGE   6             /* dither density at the peak edge (0..16) */

/* Defined in sc_input.c - serialises i2c-0 (jog read vs this display). */
extern pthread_mutex_t i2c0_lock;

/* Globals from sc_input.c */
extern unsigned int  ADCs[4];
extern unsigned char buttons[4];
extern bool          capIsTouched;

/* ---- 5x7 font (Adafruit 'classic' GLCD font, 6px cell, column-major) ------ */

static const unsigned char font5x7[] = {
    0x00, 0x00, 0x00, 0x00, 0x00,  0x3e, 0x5b, 0x4f, 0x5b, 0x3e,  0x3e, 0x6b, 0x4f, 0x6b, 0x3e,
    0x1c, 0x3e, 0x7c, 0x3e, 0x1c,  0x18, 0x3c, 0x7e, 0x3c, 0x18,  0x1c, 0x57, 0x7d, 0x57, 0x1c,
    0x1c, 0x5e, 0x7f, 0x5e, 0x1c,  0x00, 0x18, 0x3c, 0x18, 0x00,  0xff, 0xe7, 0xc3, 0xe7, 0xff,
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    0x00, 0x00, 0x00, 0x00, 0x00
};

/* ---- SSD1306 low level --------------------------------------------------- */

static int   fd = -1;
static int   err_run = 0;

/* stderr goes to a plain file at runtime (see wrapper), which stdio would
 * block-buffer - so flush after every line. */
static void olog(const char *fmt, ...)
{
    va_list ap;
    va_start(ap, fmt);
    vfprintf(stderr, fmt, ap);
    va_end(ap);
    fflush(stderr);
}

static unsigned char fb[OLED_FB_LEN];        /* what we want on screen  */
static unsigned char shadow[OLED_FB_LEN];    /* what is on screen now   */

/* One I2C write, holding i2c0_lock for just this transaction so the jog read
 * in process_rot() only ever waits behind one short transfer. Retries
 * EINTR/EAGAIN (xwax's SIGCHLD) and transient controller hiccups. */
static int oled_wr(const unsigned char *buf, size_t len)
{
    int tries, saved = 0;

    for (tries = 0; tries < 3; tries++) {
        ssize_t n;
        pthread_mutex_lock(&i2c0_lock);
        n = write(fd, buf, len);
        pthread_mutex_unlock(&i2c0_lock);
        if (n == (ssize_t)len)
            return 0;
        saved = (n < 0) ? errno : EIO;
        usleep(1000);
    }
    errno = saved;
    return -1;
}

/* Send a run of command bytes as ONE I2C transaction: control byte 0x00
 * (Co=0) means "everything up to STOP is a command". */
static int oled_cmds(const unsigned char *cmds, size_t n)
{
    unsigned char b[64];
    if (n + 1 > sizeof b) return -1;
    b[0] = 0x00;
    memcpy(b + 1, cmds, n);
    return oled_wr(b, n + 1);
}

static int oled_cmd(unsigned char c)
{
    return oled_cmds(&c, 1);
}

static const unsigned char OLED_INIT[] = {
    0xAE,
    0xD5, 0x80,
    0xA8, 0x3F,
    0xD3, 0x00,
    0x40,
    0x8D, 0x14,
    0x20, 0x00,
#if OLED_ROTATE180
    0xA0, 0xC0,
#else
    0xA1, 0xC8,
#endif
    0xDA, 0x12,
    0x81, 0x7F,
    0xD9, 0xF1,
    0xDB, 0x40,
    0xA4,
    0xA6,
    0x2E,
    0xAF
};

/* one-time init. Returns 0 on success, -1 if the panel never responds.
 * The whole init sequence is retried a few times: OLED_INIT starts with
 * 0xAE (display OFF), so a half-done init would leave the panel dark. */
static int oled_open(void)
{
    int attempt;

    fd = open(OLED_BUS, O_RDWR);
    if (fd < 0) {
        olog("OLED: open %s: %s\n", OLED_BUS, strerror(errno));
        return -1;
    }
    if (ioctl(fd, I2C_SLAVE, OLED_ADDR) < 0) {
        olog("OLED: I2C_SLAVE 0x%02x: %s\n", OLED_ADDR, strerror(errno));
        close(fd); fd = -1;
        return -1;
    }

    for (attempt = 0; attempt < 5; attempt++) {
        /* whole init sequence in ONE write */
        if (oled_cmds(OLED_INIT, sizeof OLED_INIT) == 0) {
            olog("OLED: init ok at 0x%02x on %s (attempt %d)\n",
                    OLED_ADDR, OLED_BUS, attempt);
            memset(shadow, 0xAA, sizeof shadow);   /* force a full first flush */
            return 0;
        }
        olog("OLED: init attempt %d failed (%s), retrying\n",
             attempt, strerror(errno));
        usleep(150000);
    }

    olog("OLED: init failed at 0x%02x on %s - giving up\n",
            OLED_ADDR, OLED_BUS);
    oled_cmd(0xAF);                 /* don't leave the panel switched off */
    close(fd); fd = -1;
    return -1;
}

/* Full flush of every changed page, once per call - keeps the picture
 * crisp. Each data slice is a short transaction under i2c0_lock, and after
 * each one we sched_yield() so process_rot()'s pending jog read on the same
 * bus gets serviced immediately -> no audible warble even at slow platter
 * speeds, without slowing the drawing down. */
static void oled_flush(void)
{
    int page, off;
    unsigned char pkt[1 + OLED_CHUNK];

    for (page = 0; page < OLED_PAGES; page++) {
        unsigned char *src = fb     + page * OLED_W;
        unsigned char *dst = shadow + page * OLED_W;
        unsigned char addr[3];

        if (memcmp(src, dst, OLED_W) == 0)
            continue;

        addr[0] = 0xB0 | page;
        addr[1] = 0x00;
        addr[2] = 0x10;
        if (oled_cmds(addr, 3) < 0) { err_run++; return; }
        sched_yield();

        for (off = 0; off < OLED_W; off += OLED_CHUNK) {
            int n = OLED_W - off;
            if (n > OLED_CHUNK) n = OLED_CHUNK;
            pkt[0] = 0x40;
            memcpy(pkt + 1, src + off, n);
            if (oled_wr(pkt, 1 + n) < 0) { err_run++; return; }
            sched_yield();
        }

        memcpy(dst, src, OLED_W);
        err_run = 0;
    }
}

/* ---- tiny text renderer ------------------------------------------------- */

static void draw_char(int x, int page, char c)
{
    const unsigned char *g = &font5x7[(unsigned char)c * 5];
    int col;

    for (col = 0; col < 5; col++) {
        int px = x + col;
        if (px < 0 || px >= OLED_W) continue;
        fb[page * OLED_W + px] = g[col];
    }
    /* 1px inter-char gap is left as-is (fb was cleared) */
}

static void draw_str(int x, int page, const char *s)
{
    if (page < 0 || page >= OLED_PAGES) return;
    while (*s && x < OLED_W) {
        draw_char(x, page, *s++);
        x += 6;
    }
}

/* ---- pixel helpers --------------------------------------------------- */

static void set_px(int x, int y)
{
    if ((unsigned)x >= OLED_W || (unsigned)y >= OLED_H)
        return;
    fb[(y >> 3) * OLED_W + x] |= (unsigned char)(1u << (y & 7));
}

/* 4x4 ordered-dither matrix (0..15) for fake shading on the 1-bit panel */
static const unsigned char bayer4[4][4] = {
    {  0,  8,  2, 10 },
    { 12,  4, 14,  6 },
    {  3, 11,  1,  9 },
    { 15,  7, 13,  5 }
};

/* one waveform column: crisp top+bottom outline joined to the previous
 * column, and (WF_STYLE 2) a body that dithers from dense at the centre to
 * sparse at the peak. */
static void wave_col(int x, int h, int prev_h)
{
    int y, lo, hi;

    if (h < 0) h = 0;

#if WF_STYLE == 2
    for (y = 0; y < h; y++) {
        int thr = WF_SHADE_TOP - (WF_SHADE_TOP - WF_SHADE_EDGE) * y / (h ? h : 1);
        if (bayer4[x & 3][y & 3] < thr) {
            set_px(x, WF_MID - y);
            set_px(x, WF_MID + y);
        }
    }
#elif WF_STYLE == 0
    for (y = 0; y <= h; y++) { set_px(x, WF_MID - y); set_px(x, WF_MID + y); }
#endif

    /* outline edge, connected vertically to the previous column */
    lo = (prev_h >= 0 && prev_h < h) ? prev_h : h;
    hi = (prev_h > h) ? prev_h : h;
    for (y = lo; y <= hi; y++) {
        set_px(x, WF_MID - y);
        set_px(x, WF_MID + y);
    }
}

static void vdots(int x, int y0, int y1)   /* dotted vertical cursor */
{
    int y;
    for (y = y0; y <= y1; y += 2)
        set_px(x, y);
}

/* Where the sample deck actually is in the track, in seconds.
 * xwax reads the track at (position - offset); position is a free-running
 * clock, offset is what player_seek_to()/recue() move on a cue recall.
 * Both are doubles written by the realtime thread and can tear on ARM, so
 * take a value only when two reads agree and it is sane; else keep the last. */
static double read_elapsed(struct player *pl, double lo, double hi)
{
    static double last = 0.0;
    double p1 = pl->position, o1 = pl->offset;
    double p2 = pl->position, o2 = pl->offset;

    if (p1 == p2 && o1 == o2) {
        double e = p1 - o1;
        if (e >= lo - 1.0 && e <= hi + 1.0)
            last = e;
    }
    return last;
}

/* ---- waveform view -------------------------------------------------- */

/* Zoomed waveform of the sample track, scrolling under a fixed centre
 * cursor. Uses xwax's ppm meter (1 value / 64 samples). Overlays: set cue
 * points as short ticks, and a 1px whole-track progress bar along the
 * bottom edge. Quiet samples are auto-gained so they stay visible. */
static void draw_waveform(void)
{
    struct player *pl = &deck[1].player;     /* the platter / sample deck */
    struct track *tr = pl->track;
    struct cues *cq = &deck[1].cues;
    unsigned char col[OLED_W];
    long len, pos, spp;
    int rate, x, i, wpk = 0, gnum = 1, gden = 1;

    if (tr == NULL || tr->length == 0) {
        draw_str(34, 3, "NO SAMPLE");
        return;
    }

    rate = tr->rate > 0 ? tr->rate : 48000;
    len  = tr->length;                       /* only grows during import  */
    pos  = (long)(read_elapsed(pl, -8.0, (double)len / rate) * rate);
    if (pos < 0)   pos = 0;
    if (pos > len) pos = len;

    spp = (long)(WF_WINDOW_SEC * rate) / OLED_W;   /* samples per column */
    if (spp < 1) spp = 1;

    /* pass 1: per-column peak + overall window peak */
    for (x = 0; x < OLED_W; x++) {
        long s0 = pos + (long)(x - OLED_W / 2) * spp, s;
        unsigned char p = 0;
        if (s0 >= 0 && s0 < len) {
            for (s = s0; s < s0 + spp && s < len; s += TRACK_PPM_RES) {
                unsigned char v = track_get_ppm(tr, (int)s);
                if (v > p) p = v;
            }
        }
        col[x] = p;
        if (p > wpk) wpk = p;
    }

#if WF_AUTOGAIN
    if (wpk >= 12 && wpk < 200) {            /* quiet but not silence */
        gnum = 200; gden = wpk;
        if (gnum > gden * 4) { gnum = 4; gden = 1; }   /* cap 4x */
    }
#endif

    /* pass 2: draw the wave */
    {
        int prev = -1;
        for (x = 0; x < OLED_W; x++) {
            int h = (int)col[x] * WF_AMP / 255;
            h = h * gnum / gden;
            if (h > WF_AMP) h = WF_AMP;
            wave_col(x, h, prev);
            prev = h;
        }
    }

    /* set cue points in view: a solid full-height line + a flag on top */
    for (i = 0; i < MAX_CUES; i++) {
        double cp = cq->position[i];
        int cx, y;
        if (!(cp >= 0.0 && cp < 1.0e6))      /* unset / inf / nan / garbage */
            continue;
        cx = OLED_W / 2 + (int)(((long)(cp * rate) - pos) / spp);
        if (cx < 0 || cx >= OLED_W) continue;
        for (y = 0; y <= WF_MID * 2; y++)
            set_px(cx, y);
        set_px(cx - 1, 0); set_px(cx + 1, 0);   /* flag */
        set_px(cx - 1, 1); set_px(cx + 1, 1);
        set_px(cx - 2, 0); set_px(cx + 2, 0);
    }

    /* fixed centre cursor - dotted so it stays distinct from a cue line */
    vdots(OLED_W / 2, 0, WF_MID * 2);

    /* whole-track progress bar along the bottom row */
    {
        int px = (int)(pos * (long)(OLED_W - 1) / (len > 0 ? len : 1));
        for (x = 0; x <= px && x < OLED_W; x++)
            set_px(x, OLED_H - 1);
    }
}

/* ---- the render loop -------------------------------------------------- */

static void render(void)
{
    memset(fb, 0, sizeof fb);
    draw_waveform();
}

static void *display_thread(void *arg)
{
    int beat = 0;

    (void)arg;

    /* let xwax bring up ALSA / decks / the sample track first */
    sleep(3);

    olog("OLED: display thread starting, opening %s\n", OLED_BUS);
    if (oled_open() < 0)
        return NULL;                 /* no panel -> quietly give up */

    for (;;) {
        render();
        oled_flush();

        if (err_run >= 5) {         /* panel gone? re-init and carry on */
            if (fd >= 0) { close(fd); fd = -1; }
            if (oled_open() < 0) sleep(1);
            err_run = 0;
        }

        if (++beat >= 400) {        /* ~heartbeat */
            beat = 0;
            olog("OLED: alive, err_run=%d touched=%d\n", err_run, capIsTouched);
        }
        usleep(OLED_REFRESH_US);
    }

    return NULL;
}

void SC_Display_Start(void)
{
    pthread_t t;
    if (pthread_create(&t, NULL, display_thread, NULL) != 0)
        olog("OLED: could not start display thread\n");
    else
        pthread_detach(t);
}
